## boards/shields/sofle/Kconfig.defconfig
```kconfig
if SHIELD_SOFLE_DONGLE

# Max 16 characters in keyboard name
config ZMK_KEYBOARD_NAME
    default "Tergo Sofle"

config ZMK_SPLIT_ROLE_CENTRAL
    default y

config ZMK_SPLIT
    default y

# Set this to the number of peripherals your dongle will have.
# For a unibody, this would be 1. If you have left and right halves, set it to 2, etc.
config ZMK_SPLIT_BLE_CENTRAL_PERIPHERALS
    default 2

# Set this to ZMK_SPLIT_BLE_CENTRAL_PERIPHERALS + your desired number of BT profiles (default is 5)
config BT_MAX_CONN
    default 7

# Set this to the same number as BT_MAX_CONN
config BT_MAX_PAIRED
    default 7

if ZMK_DISPLAY

config I2C
    default y

config SSD1306
    default y

choice ZMK_DISPLAY_WORK_QUEUE
    default ZMK_DISPLAY_WORK_QUEUE_DEDICATED
endchoice

if LVGL

config LV_Z_VDB_SIZE
    default 64

config LV_DPI_DEF
    default 148

config LV_Z_BITS_PER_PIXEL
    default 1

choice LV_COLOR_DEPTH
    default LV_COLOR_DEPTH_1
endchoice

endif # LVGL

endif # ZMK_DISPLAY

endif
```

## boards/shields/sofle_dongle_sh1106/Kconfig.shield
```kconfig
# No whitespace after the comma or in the keyboard name!
config SHIELD_SOFLE_DONGLE_SH1106
    def_bool $(shields_list_contains,sofle_dongle_sh1106)
```
